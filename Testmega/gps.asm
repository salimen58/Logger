;;;;;;;;;;;;;;;;;;;;;;;;;;;;;;;;;;;;;;;;;;;;;;;;;;;;;;;;;;;;;;;;;;;;;;;;;;;;;;;;;;;;;;;;;;;;;;;;;;;;;;;;;;;;;

          #include <P16F628A.INC>
            LIST        p=16F628A     
            __CONFIG    H'3F18'             ;Конфигурация микроконтроллера
                                               
Sec           equ         20h               ;вспомогательный регистр счета
Sec1          equ         21h               ;вспомогательный регистр счета
nomer         equ         22h               ;регистр хранения кода ascii символа
scetbit       equ         23h               ;регистр счета кол-ва бит для spi 
perem         equ         24h               ;промежуточный регистр хранения передаваемого байта по spi             
priem         equ         28h               ;промежуточный регистр хранения данных полученных по UART    
temp          equ         29h               ;вспомогательный регистр счета
tmp_symb      equ         2Ah               ;вспомогательный регистр счета для таблицы данных 
sp_h          equ         2Bh               ;старший регистр хранения кол-ва использованных спутников
sp_l          equ         2Ch               ;младший регистр хранения кол-ва использованных спутников

flag          equ         78h               ;регистр флагов
FSR_prer      equ         7Bh               ;регистр хранения значения FSR для обработчика прерываний
W_TEMP        equ         7Dh               ;регистр хранения значения аккумулятора W
STATUS_TEMP   equ         7Eh               ;регистр хранения значения STATUS
FSR_temp      equ         7Fh               ;регистр хранения значения FSR для основной программы

data_gps      equ         00A0h             ;адрес первого регистра для хранения сообщений от модуля GPS

#DEFINE       sdata       PORTB,3           ;присвоение названий линиям ввода-вывода
#DEFINE       sclk        PORTB,4           ;для работы с LCD дисплеем
#DEFINE       dat_com     PORTB,5           ;
#DEFINE       res_lcd     PORTB,0           ;
#DEFINE       cs          PORTB,6           ;
#DEFINE       led         PORTB,7           ;светодиод индикации приема сообщения "GPRMC" от GPS модуля

;;;;;;;;;;;;;;;;;;;;;;;;;;;;;;;;;;;;;;;;;;;;;;;;;;;;;;;;;;;;;;;;;;;;;;;;;;;;;;;;;;;;;;;;;;;;;;;;;;;;;;;;;;;;;;;


              org         0000h             ;начать выполнение программы с адреса 0000h
              goto        Start             ;переход на метку Start
           
;;;;;;;;;;;;;;;;;;;;;;;;;;;;;;;;;;;;;;;;;;;;;;;;;;;;;;;;;;;;;;;;;;;;;;;;;;;;;;;;;;;;;;;;;;;;;;;;;;;;;;;;;;;;;;;;
;Подпрограмма обработки прерываний

              org         0004h             ;начать выполнение подпрограммы с адреса 0004h
       
              movwf       W_TEMP            ;сохранение значений ключевых регистров
              swapf       STATUS,W          ;
              clrf        STATUS            ;
              movwf       STATUS_TEMP       ;

              movf        FSR,W             ;сохранение текущего значения регистра FSR, и 
              movwf       FSR_temp          ;восстановление ранее сохраненного значения 
              movf        FSR_prer,W        ;
              movwf       FSR               ;
                
priem_usart   movf        RCREG,W           ;сохранение байта полученного по UART в регистр INDF
              movwf       INDF              ;проверка сохраненного значения на совпадение 
              movlw       '$'               ;с символом "$"
              xorwf       INDF,W            ;
              btfss       STATUS,Z          ;
              goto        priem_1           ;нет совпадения: переход на метку priem_1
              movlw       data_gps          ;есть совпадение: установка адреса первого регистра  
              movwf       FSR               ;для загрузки сообщений от GPS модуля
              goto        exxit             ;переход на метку exxit

priem_1       movlw       0x0D              ;проверка сохраненного значения на совпадение
              xorwf       INDF,W            ;с символом возврата каретки 0x0D
              btfss       STATUS,Z          ;
              goto        priem_2           ;нет совпадения: переход на метку priem_2
              bsf         flag,0            ;есть совпадение: установка флага получения сообщения от GPS модуля
              goto        exxit             ;переход на метку exxit
           
priem_2       incf        FSR,F             ;инкремент регистра FSR: установка адреса следующего регистра
              movlw       0xF0              ;защита от переполнения банка памяти
              xorwf       FSR,W             ;проверка значения регистра FSR на совпадение
              btfss       STATUS,Z          ;с числом 0xF0 
              goto        exxit             ;нет совпадения: переход на метку exxit
              movlw       data_gps          ;есть совпадение: установка адреса первого регистра 
              movwf       FSR               ;для загрузки сообщений от GPS модуля
                                           

exxit         movf        FSR,W             ;сохранение текущего значения регистра FSR, и 
              movwf       FSR_prer          ;восстановление ранее сохраненного значения
              movf        FSR_temp,W        ;
              movwf       FSR               ;            

              swapf       STATUS_TEMP,W     ;восстановление содержимого ключевых регистров
              movwf       STATUS            ;
              swapf       W_TEMP,F          ;
              swapf       W_TEMP,W          ;
                                            ;
              retfie                        ;выход из подпрограммы обработки прерывания

;;;;;;;;;;;;;;;;;;;;;;;;;;;;;;;;;;;;;;;;;;;;;;;;;;;;;;;;;;;;;;;;;;;;;;;;;;;;;;;;;;;;;;;;;;;;;;;;;;;;;;;;;;;;;;;;;;;;;
;Основная программа
                                             
Start         clrf        PORTA             ;сброс регистра PORTA
              movlw       b'01000001'       ;установка значений выходных защелок порта B     
              movwf       PORTB             ; 
              
              movlw       b'00000111'       ;выключение компараторов
              movwf       CMCON             ;

              bsf         STATUS,RP0        ;выбрать 1-й банк    
              movlw       b'00000110'       ;настройка линий ввода\вывода порта B      
              movwf       TRISB             ;RB1,RB2,RB7 - на вход, остальные на выход
 
              movlw       b'11111111'       ;настройка линий ввода\вывода порта A   
              movwf       TRISA             ;все линии на вход
             
              movlw       0x19              ;запись числа 0x19 в регистр SPBRG для задания  
              movwf       SPBRG             ;скорости обмена USART, для частоты тактового 
                                            ;генератора в 4МГц скорость составит 9600 бит/сек

              movlw       b'00100100'       ;настройка модуля USART: выбор асинхронного 
              movwf       TXSTA             ;высокоскоростного режима USART,
                                            ;настройка модуля передатчика USART: 8-ми битная
                                            ;передача, разрешение передачи                           
              bcf         STATUS,RP0        ;выбрать 0-й банк 
                                            
              movlw       b'10010000'       ;настройка модуля USART: включение модуля USART
              movwf       RCSTA             ;настройка модуля приемника USART: 8-ми битный
                                            ;прием, разрешение приема
                     
              clrf        flag              ;сброс регистра флагов  
  
              movlw       data_gps          ;запись адреса первого регистра (регистры хранения сообщений от 
              movwf       FSR_prer          ;модуля GPS) в регистр FSR_prer, выполняется однократно 
                                            ;после включения питания
                          
              bsf         STATUS,RP0        ;выбрать 1-й банк 
              bsf         PIE1,RCIE         ;разрешение прерываний от приемника USART
              bcf         STATUS,RP0        ;выбрать 0-й банк
              bsf         INTCON,PEIE       ;разрешение прерывания периферийных модулей
              bsf         INTCON,GIE        ;глобальное разрешение прерываний            
              
              call        init_lcd          ;вызов подпрограммы инициализации дисплея
              call        clear_lcd         ;вызов подпрограммы очистки дисплея
              call        viv_not           ;вывод на дисплей сообщения "--- "

;;;;;;;;;;;;;;;;;;;;;;;;;;;;;;;;;;;;;;;;;;;;;;;;;;;;;;;;;;;;;;;;;;;;;;;;;;;;;;;;;;;;;;;;;;;;;;;;;;;;;;;;;;;;;;;;;;;;
              
gps_start     bcf         flag,0            ;сброс флага получения сообщения от GPS модуля
gps_a0        btfss       flag,0            ;опрос флага получения сообщения от GPS модуля
              goto        gps_a0            ;сообщение не получено: переход на метку gps_a0

                                            ;сообщение получено:
              movlw       .0                ;проверка первых четырех символов сообщения на  
              call        srav_gps          ;совпадение с символами "GPRMC" путем вызова 
              btfss       flag,1            ;подпрограммы сравнения srav_gps 
              goto        gps_a1            ;нет совпадения: переход на метку gps_a1
              bsf         led               ;включение светодиода индикации приема
              call        gps_gprmc         ;есть совпадение: вызов подпрограммы gps_gprmc 
              bcf         led               ;выключение светодиода индикации приема
              goto        gps_start         ;переход на метку gps_start

gps_a1        movlw       .5                ;проверка первых четырех символов сообщения на
              call        srav_gps          ;совпадение с символами "GPVTG" путем вызова 
              btfss       flag,1            ;подпрограммы сравнения srav_gps
              goto        gps_a2            ;нет совпадения: переход на метку gps_a2
              call        gps_gpvtg         ;есть совпадение: вызов подпрограммы gps_gpvtg
              goto        gps_start         ;переход на метку gps_start

gps_a2        movlw       .10               ;проверка первых четырех символов сообщения на
              call        srav_gps          ;совпадение с символами "GPGGA" путем вызова
              btfss       flag,1            ;подпрограммы сравнения srav_gps
              goto        gps_a3            ;нет совпадения: переход на метку gps_a3
              call        gps_gpgga         ;есть совпадение: вызов подпрограммы gps_gpgga
              goto        gps_start         ;переход на метку gps_start

gps_a3        movlw       .15               ;проверка первых четырех символов сообщения на
              call        srav_gps          ;совпадение с символами "GPGSV" путем вызова
              btfss       flag,1            ;подпрограммы сравнения srav_gps
              goto        gps_start         ;нет совпадения: переход на метку gps_start
              call        gps_gpgsv         ;есть совпадение: вызов подпрограммы gps_gpgsv
              goto        gps_start         ;переход на метку gps_start

;;;;;;;;;;;;;;;;;;;;;;;;;;;;;;;;;;;;;;;;;;;;;;;;;;;;;;;;;;;;;;;;;;;;;;;;;;;;;;;;;;;;;;;;;;;;;;;;;;;;;;;;;;;;;;;;;;;;;;;;;;;      
;подпрограмма анализа сообщения "GPRMC", поиск и вывод на дисплей 
;значения полей времени, координат, статуса достоверности
                                            
gps_gprmc     call        ust_cur_1         ;вызов подпрограммы установки позиции курсора на Lcd дисплее
              incf        FSR,F             ;инкремент регистра FSR 
              call        prov_symb         ;проверка первого символа поля, содержащего информацию о времени 
              btfss       flag,2            ;
              goto        time_1            ;есть данные о времени: переход на метку time_1
              call        viv_not           ;обнаружен символ "," нет данных о времени: вывод на дисплей сообщения "--- " 
              goto        status_1          ;переход на метку status_1
             
time_1        movf        INDF,W            ;
              call        viv_symb          ;вывод значения часов, разряд десятков 
      
              incf        FSR,F             ;инкремент регистра FSR  
              call        prov_symb         ;проверка окончания поля, факт совпадения с символом ","
              btfsc       flag,2            ;
              goto        status_1           ;обнаружен символ "," конец поля: переход на метку status_1
              movf        INDF,W            ;
              call        viv_symb          ;вывод значения часов, разряд единиц
              movlw       ':'               ;
              call        viv_symb          ;вывод разделителя, символ ":"

              incf        FSR,F             ;инкремент регистра FSR
              call        prov_symb         ;проверка окончания поля, факт совпадения с символом ","
              btfsc       flag,2            ;
              goto        status_1           ;обнаружен символ "," конец поля: переход на метку status_1
              movf        INDF,W            ;
              call        viv_symb          ;вывод значения минут, разряд десятков

              incf        FSR,F             ;инкремент регистра FSR
              call        prov_symb         ;проверка окончания поля, факт совпадения с символом ","
              btfsc       flag,2            ;
              goto        status_1           ;обнаружен символ "," конец поля: переход на метку status_1
              movf        INDF,W            ;
              call        viv_symb          ;вывод значения минут, разряд единиц
              movlw       ':'               ;
              call        viv_symb          ;вывод разделителя, символ ":"
              
              incf        FSR,F             ;инкремент регистра FSR
              call        prov_symb         ;проверка окончания поля, факт совпадения с символом ","
              btfsc       flag,2            ;
              goto        status_1           ;обнаружен символ "," конец поля: переход на метку status_1
              movf        INDF,W            ;
              call        viv_symb          ;вывод значения секунд, разряд десятков

              incf        FSR,F             ;инкремент регистра FSR
              call        prov_symb         ;проверка окончания поля, факт совпадения с символом ","
              btfsc       flag,2            ;
              goto        status_1          ;обнаружен символ "," конец поля: переход на метку status_1
              movf        INDF,W            ;
              call        viv_symb          ;вывод значения секунд, разряд единиц

time_2        incf        FSR,F             ;пропуск символов, поиск символа "," окончания поля
              call        prov_symb         ;проверка окончания поля, факт совпадения с символом ","
              btfss       flag,2            ;
              goto        time_2            ;символ "," не обнаружен: переход на метку time_2

status_1      call        ust_cur_st        ;вызов подпрограммы установки позиции курсора на Lcd дисплее
              incf        FSR,F             ;инкремент регистра FSR
              call        prov_symb         ;проверка окончания поля, факт совпадения с символом ","
              btfsc       flag,2            ;
              goto        kord_NS_1         ;обнаружен символ "," нет статуса достоверности: переход на метку kord_NS_1
              movf        INDF,W            ;
              call        viv_symb          ;вывод значения статуса достоверности             
                        
              incf        FSR,F             ;инкремент регистра FSR
kord_NS_1     incf        FSR,F             ;инкремент регистра FSR
              call        ust_cur_2         ;вызов подпрограммы установки позиции курсора на Lcd дисплее

              call        prov_symb         ;проверка первого символа поля, содержащего координаты широты   
              btfss       flag,2            ;
              goto        kord_NS_2         ;есть данные о координатах: переход на метку kord_NS_2
              call        viv_not           ;обнаружен символ "," нет данных о координатах: вывод на дисплей сообщения "--- "
              goto        tip_NS_1          ;переход на метку tip_NS_1

kord_NS_2     movf        INDF,W            ;
              call        viv_symb          ;вывод координат широты (градусы), разряд десятков
              incf        FSR,F             ;инкремент регистра FSR
              call        prov_symb         ;проверка окончания поля, факт совпадения с символом ","
              btfsc       flag,2            ;
              goto        tip_NS_1          ;обнаружен символ "," конец поля: переход на метку tip_NS_1
              movf        INDF,W            ;       
              call        viv_symb          ;вывод координат широты (градусы), разряд единиц     
              movlw       ' '               ;
              call        viv_symb          ;вывод разделителя, символ " "

kord_NS_3     incf        FSR,F             ;инкремент регистра FSR
              call        prov_symb         ;проверка окончания поля, факт совпадения с символом ","
              btfsc       flag,2 
              goto        tip_NS_1          ;обнаружен символом ",": переход на метку tip_NS_1
              movf        INDF,W            ;   
              call        viv_symb          ;вывод координат широты (минуты)
              goto        kord_NS_3         ;переход на метку kord_NS_3
 
tip_NS_1      incf        FSR,F             ;инкремент регистра FSR
              call        prov_symb         ;проверка типа широты
              btfsc       flag,2            ;
              goto        kord_WE_1         ;обнаружен символ "," тип широты отсутствует: переход на метку kord_WE_1
              movf        INDF,W            ;
              call        viv_symb          ;вывод типа широты (северная, южная)

              incf        FSR,F             ;инкремент регистра FSR
kord_WE_1     incf        FSR,F             ;инкремент регистра FSR
              call        ust_cur_3         ;вызов подпрограммы установки позиции курсора на Lcd дисплее 
              call        prov_symb         ;проверка первого символа поля, содержащего координаты долготы
              btfss       flag,2            ;
              goto        kord_WE_2         ;есть данные о координатах: переход на метку kord_WE_2
              call        viv_not           ;обнаружен символ "," нет данных о координатах: вывод на дисплей сообщения "--- "
              return                        ;возврат из подпрограммы gps_gprmc

kord_WE_2     movf        INDF,W            ;
              call        viv_symb          ;вывод координат долготы (градусы), разряд сотен
              incf        FSR,F             ;инкремент регистра FSR
              call        prov_symb         ;проверка окончания поля, факт совпадения с символом ","
              btfsc       flag,2            ;
              goto        tip_WE_1          ;обнаружен символ "," конец поля: переход на метку tip_WE_1
              movf        INDF,W            ;
              call        viv_symb          ;вывод координат долготы (градусы), разряд десятков
              incf        FSR,F             ;инкремент регистра FSR
              call        prov_symb         ;проверка окончания поля, факт совпадения с символом ","
              btfsc       flag,2            ;
              goto        tip_WE_1          ;обнаружен символ "," конец поля: переход на метку tip_WE_1
              movf        INDF,W            ;
              call        viv_symb          ;вывод координат долготы (градусы), разряд единиц  
              movlw       ' '               ;
              call        viv_symb          ;вывод разделителя, символ " "
              
kord_WE_3     incf        FSR,F             ;инкремент регистра FSR
              call        prov_symb         ;проверка окончания поля, факт совпадения с символом ","
              btfsc       flag,2            ;
              goto        tip_WE_1          ;обнаружен символом ",": переход на метку tip_WE_1
              movf        INDF,W           
              call        viv_symb          ;вывод координат долготы (минуты)
              goto        kord_WE_3         ;переход на метку kord_WE_3
              
tip_WE_1      incf        FSR,F             ;инкремент регистра FSR
              call        prov_symb         ;проверка типа долготы
              btfsc       flag,2            ;
              return                        ;обнаружен символ "," тип долготы отсутствует: возврат из подпрограммы gps_gprmc
              movf        INDF,W            ;
              call        viv_symb          ;вывод типа долготы (западная, восточная)
              return                        ;возврат из подпрограммы gps_gprmc

;;;;;;;;;;;;;;;;;;;;;;;;;;;;;;;;;;;;;;;;;;;;;;;;;;;;;;;;;;;;;;;;;;;;;;;;;;;;;;;;;;;;;;;;;;;;;;;;;;;;;;;;;;;;;;;;;;;;;;;;;;;;;;
;подпрограмма анализа сообщения "GPVTG", поиск и вывод на дисплей значения скорости перемещения

gps_gpvtg     call        ust_cur_4         ;вызов подпрограммы установки позиции курсора на Lcd дисплее

              movlw       .6                ;пропуск 3-x полей
              movwf       temp              ;
gpvtg_1       incf        FSR,F             ;инкремент регистра FSR 
              call        prov_symb         ;проверка окончания поля, факт совпадения с символом ","
              btfss       flag,2            ;
              goto        gpvtg_1           ;символ "," не обнаружен: переход на метку gpvtg_1
              decfsz      temp,F            ;обнаружен символ "," конец поля: декремент регистра temp
              goto        gpvtg_1           ;значение регистра не равно 0: переход на метку gpvtg_1
              
              incf        FSR,F             ;инкремент регистра FSR
              call        prov_symb         ;проверка первого символа поля, содержащего значение скорости    
              btfss       flag,2            ;
              goto        gpvtg_2           ;есть данные о скорости: переход на метку gpvtg_2
              call        viv_not           ;обнаружен символ "," нет данных о скорости: вывод на дисплей сообщения "--- "
              return                        ;;возврат из подпрограммы gps_gpvtg

gpvtg_2       movf        INDF,W            ;
              call        viv_symb          ;вывод значения скорости
              incf        FSR,F             ;инкремент регистра FSR
              call        prov_symb         ;проверка окончания поля, факт совпадения с символом ","
              btfss       flag,2            ;
              goto        gpvtg_2           ;символом "," не обнаружен: переход на метку gpvtg_2

              incf        FSR,F             ;инкремент регистра FSR
              call        prov_symb         ;проверка единицы измерения
              btfsc       flag,2            ;
              return                        ;обнаружен символ "," единица измерения отсутствует: возврат из подпрограммы gps_gpvtg
              movf        INDF,W            ;
              call        viv_symb          ;вывод единицы измерения (K)
              return                        ;возврат из подпрограммы gps_gpvtg

;;;;;;;;;;;;;;;;;;;;;;;;;;;;;;;;;;;;;;;;;;;;;;;;;;;;;;;;;;;;;;;;;;;;;;;;;;;;;;;;;;;;;;;;;;;;;;;;;;;;;;;;;;;;;;;;;;;;;;;;;;;;;;
;подпрограмма анализа сообщения "GPGGA", поиск и вывод на дисплей значения высоты и кол-ва использованных спутников 

gps_gpgga     call        ust_cur_5         ;вызов подпрограммы установки позиции курсора на Lcd дисплее

              movlw       .6                ;пропуск 4-x полей
              movwf       temp              ;
gpgga_1       incf        FSR,F             ;инкремент регистра FSR 
              call        prov_symb         ;проверка окончания поля, факт совпадения с символом ","
              btfss       flag,2            ;
              goto        gpgga_1           ;символ "," не обнаружен: переход на метку gpgga_1
              decfsz      temp,F            ;обнаружен символ "," конец поля: декремент регистра temp
              goto        gpgga_1           ;значение регистра не равно 0: переход на метку gpgga_1
              
              incf        FSR,F             ;инкремент регистра FSR
              call        prov_symb         ;проверка первого символа поля, содержащего кол-во использован. спутников
              btfsc       flag,2            ;
              goto        sput_1            ;обнаружен символ "," нет данных о спутниках: переход на метку sput_1
              movf        INDF,W            ;
              movwf       sp_h              ;сохранение числа использованных спутников в регистр sp_h, разряд десятков
              incf        FSR,F             ;инкремент регистра FSR
              call        prov_symb         ;проверка окончания поля, факт совпадения с символом ","
              btfsc       flag,2            ;
              goto        sput_1            ;обнаружен символ ",": переход на метку sput_1
              movf        INDF,W            ;
              movwf       sp_l              ;сохранение числа использованных спутников в регистр sp_l, разряд единиц            
              movlw       .2                ;запись числа в W, для счетчика пропуска запятых, пропуск 2-х запятых 
              goto        sput_2 

sput_1        movlw       .1                ;пропуск одной запятой
sput_2        movwf       temp              ;
sput_3        incf        FSR,F             ;инкремент регистра FSR 
              call        prov_symb         ;проверка окончания поля, факт совпадения с символом ","
              btfss       flag,2            ;
              goto        sput_3            ;символ "," не обнаружен: переход на метку sput_3
              decfsz      temp,F            ;обнаружен символ "," конец поля: декремент регистра temp
              goto        sput_3            ;значение регистра не равно 0: переход на метку sput_3

              incf        FSR,F             ;инкремент регистра FSR 
              call        prov_symb         ;проверка первого символа поля, содержащего значение высоты
              btfss       flag,2            ;
              goto        visota_1          ;есть данные о высоте: переход на метку visota_1
              call        viv_not           ;обнаружен символ "," нет данных о высоте: вывод на дисплей сообщения "--- "
              goto        viv_sp            ;переход на метку viv_sp

visota_1      movf        INDF,W            ;
              call        viv_symb          ;вывод высоты
              incf        FSR,F             ;инкремент регистра FSR
              call        prov_symb         ;проверка окончания поля, факт совпадения с символом "," 
              btfss       flag,2            ;
              goto        visota_1          ;символом "," не обнаружен: переход на метку visota_1

              incf        FSR,F             ;инкремент регистра FSR
              call        prov_symb         ;проверка единицы измерения
              btfsc       flag,2            ;
              goto        viv_sp            ;обнаружен символ "," единица измерения отсутствует: переход на метку viv_sp
              movf        INDF,W            ;
              call        viv_symb          ;вывод единицы измерения (M)
 
viv_sp        call        ust_cur_6         ;вызов подпрограммы установки позиции курсора на Lcd дисплее
              movf        sp_h,W            ;
              call        viv_symb          ;вывод кол-ва использованных спутников, разряд десятков
              movf        sp_l,W            ;
              call        viv_symb          ;вывод кол-ва использованных спутников, разряд единиц
              movlw       '/'               ;
              call        viv_symb          ;вывод символа "/"
              return                        ;возврат из подпрограммы gps_gpgga

;;;;;;;;;;;;;;;;;;;;;;;;;;;;;;;;;;;;;;;;;;;;;;;;;;;;;;;;;;;;;;;;;;;;;;;;;;;;;;;;;;;;;;;;;;;;;;;;;;;;;;;;;;;;;;;;;;;;;;;;;;;;;;
;подпрограмма анализа сообщения "GPGSV", поиск и вывод на дисплей кол-ва видимых спутников 

gps_gpgsv     call        ust_cur_sp        ;вызов подпрограммы установки позиции курсора на Lcd дисплее  
            
              movlw       .2                ;пропуск 2-x параметров
              movwf       temp              ;
gpgsv_1       incf        FSR,F             ; 
              call        prov_symb         ;
              btfss       flag,2            ;
              goto        gpgsv_1           ;
              decfsz      temp,F            ;
              goto        gpgsv_1           ;

              movlw       '/'               ;
              call        viv_symb          ;вывод символа "/"     
              incf        FSR,F             ;инкремент регистра FSR
              call        prov_symb         ;проверка первого символа поля, содержащего кол-во видимых спутников
              btfsc       flag,2            ;
              return                        ;обнаружен символ "," нет данных о спутниках: выход из подпрограммы gps_gpgsv
              movf        INDF,W            ;
              call        viv_symb          ;вывод кол-ва видимых спутников, разряд десятков
              incf        FSR,F             ;инкремент регистра FSR
              call        prov_symb         ;проверка окончания поля, факт совпадения с символом ","
              btfsc       flag,2            ;
              return                        ;обнаружен символ ",": выход из подпрограммы gps_gpgsv
              movf        INDF,W            ;вывод кол-ва видимых спутников, разряд единиц
              call        viv_symb          ;
              return                        ;выход из подпрограммы gps_gpgsv

;;;;;;;;;;;;;;;;;;;;;;;;;;;;;;;;;;;;;;;;;;;;;;;;;;;;;;;;;;;;;;;;;;;;;;;;;;;;;;;;;;;;;;;;;;;;;;;;;;;;;;;;;;;;;;;;;;;;;;;;;;;;;;;;;;;;;;;

                                            ;Подпрограмма проверки содержимого регистра INDF на совпадение с символом ","
prov_symb     bcf         flag,2            ;сброс флага совпадения
              movlw       ','               ;
              xorwf       INDF,W            ;
              btfss       STATUS,Z          ;
              return                        ;нет совпадения: выход из подпрограммы
              bsf         flag,2            ;есть совпадение: установка флага совпадения
              return                        ;выход из подпрограммы
                  
viv_not       movlw       '-'               ;Подпрограмма вывода на дисплей сообщения (--- )
              call        viv_symb          ;вывод символа "-" 
              movlw       '-'               ;
              call        viv_symb          ;вывод символа "-" 
              movlw       '-'               ;
              call        viv_symb          ;вывод символа "-" 
              movlw       ' '               ;
              call        viv_symb          ;вывод символа " " 
              return                        ;выход из подпрограммы

;;;;;;;;;;;;;;;;;;;;;;;;;;;;;;;;;;;;;;;;;;;;;;;;;;;;;;;;;;;;;;;;;;;;;;;;;;;;;;;;;;;;;;;;;;;;;;;;;;;;;;;;;;;;;;;;;;;;;;;;;;;
;Подпрограмма проверки 4-х символов загруженных в память на совпадение с символами хранящиеся в таблице данных
;Сравнение при помощи косвенной адресации

srav_gps      movwf       nomer             ;сохранение условного номера символа в таблице данных     
              movlw       .5                ;зпись счетчика для отсчета кол-ва сравнений
              movwf       temp              ;
              bcf         flag,1            ;сброс флага совпадения символов
              movlw       data_gps          ;запись адреса первого регистра (регистры хранения сообщений от 
              movwf       FSR               ;(модуля GPS) в регистр FSR_prer
                       
srav_1        call        table             ;вызов подпрограммы таблицы данных             
              xorwf       INDF,W            ;сравнение символа из таблицы данных с символом загруженным в память
              btfss       STATUS,Z          ;
              return                        ;нет совпадения: выход из подпрограммы
              incf        FSR,F             ;есть слвпадение, инкремент регистра FSR
              incf        nomer,F           ;инкремент условного номера смивола в иаблице данных
              decfsz      temp,F            ;декремент счетчика кол-ва сравнений
              goto        srav_1            ;счетчик не равен нулю: переход на метку srav_1
              bsf         flag,1            ;счетчик равен нулю: установка флага совпадения символов
              return                        ;выход из подпрограммы
             
table         movlw       high tab          ;таблица хранения последовательности ascii символов 
              movwf       PCLATH            ;
              movf        nomer,W           ;
              addlw       low tab           ;
              btfsc       STATUS,C          ;
              incf        PCLATH,F          ;
              movf        nomer,W           ;
              addwf       PCL,F             ;
 
tab           dt 'G', 'P', 'R', 'M', 'C';   ;условный номер первого симаолв = 0
              dt 'G', 'P', 'V', 'T', 'G';   ;условный номер первого симаолв = 5
              dt 'G', 'P', 'G', 'G', 'A';   ;условный номер первого симаолв = 10
              dt 'G', 'P', 'G', 'S', 'V';   ;условный номер первого симаолв = 15              
              

init_lcd      bcf        res_lcd           ;подпрограмма инициализации дисплея       
              nop
              nop
              bsf        res_lcd 
              nop
              nop 
              bcf        cs      
                         
              movlw      0x21              ;включить контроллер дисплея, горизонт.адресация, расширенный набор команд
              call       sendispcom        ;
              movlw      0x13              ;установка смещения напряжения Bias 1:48
              call       sendispcom        ;
              movlw      0x04              ;установка температурной компенсации 4
              call       sendispcom
              movlw      0xC1              ;установка контрастности (напряжение Vop) 6,42В (0хB8)
              call       sendispcom
              movlw      0x20              ;стандартный набор команд
              call       sendispcom  
              movlw      0x0C              ;установка - нормальный режим работы
              call       sendispcom 
              return


ust_cur_1     movlw       0x40              ;установка курсор в позицию Y0
              call        sendispcom
              goto        ust
ust_cur_2     movlw       0x41              ;установка курсор в позицию Y1
              call        sendispcom
              goto        ust
ust_cur_3     movlw       0x42              ;установка курсор в позицию Y2
              call        sendispcom
              goto        ust
ust_cur_4     movlw       0x43              ;установка курсор в позицию Y3
              call        sendispcom
              goto        ust
ust_cur_5     movlw       0x44              ;установка курсор в позицию Y4
              call        sendispcom
              goto        ust
ust_cur_6     movlw       0x45              ;установка курсор в позицию Y5
              call        sendispcom
ust           movlw       0x80              ;установка курсор в позицию X0
              call        sendispcom
              return
              
ust_cur_sp    movlw       0x45              ;установка курсор в позицию Y5
              call        sendispcom
              movlw       0x8C              ;установка курсор в позицию X12
              call        sendispcom
              return

ust_cur_st    movlw       0xC2              ;установка курсор в позицию X66
              call        sendispcom
              return


clear_lcd     movlw      0x40              ;подпрограмма очистки дисплея
              call       sendispcom 
              movlw      0x80              
              call       sendispcom 
              movlw      .6
              movwf      Sec1
povt4         movlw      .84
              movwf      Sec
povt3         movlw      .0
              call       sendispdat
              decfsz     Sec,F             
              goto       povt3
              decfsz     Sec1,F             
              goto       povt4
              return

sendispcom    movwf      perem            ;подпрограмма отправки байта на дисплей
              bcf        dat_com
              goto       povt1
sendispdat    movwf      perem
              bsf        dat_com
povt1         movlw      .8
              movwf      scetbit
povt2         bcf        sclk
              btfsc      perem,7
              bsf        sdata
              btfss      perem,7
              bcf        sdata
              bsf        sclk                                   
              rlf        perem,F
              decfsz     scetbit,F             
              goto       povt2
              bcf        sclk
              return

viv_symb      movwf       nomer             ;подпрограмма вывода символа на дисплей
              movlw       .48
              subwf       nomer,W
              btfss       STATUS,C
              goto        viv_3

viv_1         movf        nomer,W
              sublw       .57
              btfsc       STATUS,C
              goto        viv_2
viv_3         call        kod_ascii
              goto        symb_lcd
              
viv_2         movlw       .48
              subwf       nomer,F
              
symb_lcd      movf        nomer,W
              addwf       nomer,F
              addwf       nomer,F
              addwf       nomer,F
              addwf       nomer,F
              movlw       .5
              movwf       temp
              decf        nomer,F
symb_1        incf        nomer,F             
              call        tab_symb
              call        sendispdat
              decfsz      temp,F
              goto        symb_1
              movlw       .0
              call        sendispdat
              return

tab_symb      movlw       high tab1         ;таблица символов для Lcd дисплея
              movwf       PCLATH            ;
              movf        nomer,W           ;
              addlw       low tab1          ;
              btfsc       STATUS,C          ;
              incf        PCLATH,F          ;
              movf        nomer,W           ;
              addwf       PCL,F  
                                                  
tab1          dt 0x3E, 0x51, 0x49, 0x45, 0x3E;       ; 0      (48)
              dt 0x00, 0x42, 0x7F, 0x40, 0x00;       ; 1 
              dt 0x42, 0x61, 0x51, 0x49, 0x46;       ; 2 
              dt 0x21, 0x41, 0x45, 0x4B, 0x31;       ; 3 
              dt 0x18, 0x14, 0x12, 0x7F, 0x10;       ; 4 
              dt 0x27, 0x45, 0x45, 0x45, 0x39;       ; 5 
              dt 0x3C, 0x4A, 0x49, 0x49, 0x30;       ; 6 
              dt 0x01, 0x71, 0x09, 0x05, 0x03;       ; 7 
              dt 0x36, 0x49, 0x49, 0x49, 0x36;       ; 8 
              dt 0x06, 0x49, 0x49, 0x29, 0x1E;       ; 9      (57)

              dt 0x00, 0x00, 0x00, 0x00, 0x00;       ;(space) (32)
              dt 0x08, 0x08, 0x08, 0x08, 0x08;       ; -      (45)
              dt 0x00, 0x60, 0x60, 0x00, 0x00;       ; .      (46)
              dt 0x20, 0x10, 0x08, 0x04, 0x02;       ; /      (47) 
              dt 0x00, 0x36, 0x36, 0x00, 0x00;       ; :      (58)       
              dt 0x7E, 0x11, 0x11, 0x11, 0x7E;       ; A      (65)
              dt 0x7F, 0x49, 0x49, 0x49, 0x41;       ; E      (69)
              dt 0x7F, 0x08, 0x14, 0x22, 0x41;       ; K      (75)
              dt 0x7F, 0x02, 0x04, 0x02, 0x7F;       ; M      (77)
              dt 0x7F, 0x04, 0x08, 0x10, 0x7F;       ; N      (78)
              dt 0x46, 0x49, 0x49, 0x49, 0x31;       ; S      (83)
              dt 0x1F, 0x20, 0x40, 0x20, 0x1F;       ; V      (86)
              dt 0x7F, 0x20, 0x18, 0x20, 0x7F;       ; W      (87)



kod_ascii     movlw       .255              ;таблица ascii символов
              movwf       tmp_symb
kod_1         incf        tmp_symb,F
              call        tab_ascii
              xorwf       nomer,W
              btfss       STATUS,Z
              goto        kod_1
              movlw       .10
              addwf       tmp_symb,W
              movwf       nomer
              return
              
tab_ascii     movlw       high tab2         ;
              movwf       PCLATH            ;
              movf        tmp_symb,W        ;
              addlw       low tab2          ;
              btfsc       STATUS,C          ;
              incf        PCLATH,F          ;
              movf        tmp_symb,W        ;
              addwf       PCL,F  
                                                  
tab2          dt ' ', '-', '.', '/', ':', 'A';      
              dt 'E', 'K', 'M', 'N', 'S', 'V', 'W';

              end                         ;конец всей программы